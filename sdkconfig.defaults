## sdkconfig.defaults
```kconfig
# ============================================================
# sdkconfig.defaults — CámaraESP32 con OV5640
# Freenove ESP32-S3-WROOM CAM (N16R8)
# ============================================================

# Chip target
CONFIG_IDF_TARGET="esp32s3"

# CPU & Performance
CONFIG_ESP32S3_DEFAULT_CPU_FREQ_240=y
CONFIG_FREERTOS_HZ=1000

# PSRAM — 8MB OPI PSRAM (Octal SPI, Freenove N16R8)
CONFIG_ESP32S3_SPIRAM_SUPPORT=y
CONFIG_SPIRAM_MODE_OCT=y
CONFIG_SPIRAM_SPEED_80M=y
CONFIG_SPIRAM_USE_MALLOC=y
CONFIG_SPIRAM_MALLOC_ALWAYSINTERNAL=16384
CONFIG_SPIRAM_MALLOC_RESERVE_INTERNAL=32768
CONFIG_SPIRAM_ALLOW_BSS_SEG_EXTERNAL_MEMORY=y

# Flash
CONFIG_ESPTOOLPY_FLASHSIZE_8MB=y
CONFIG_PARTITION_TABLE_CUSTOM=y
CONFIG_PARTITION_TABLE_CUSTOM_FILENAME="partitions.csv"

# Camera
CONFIG_CAMERA_TASK_STACK_SIZE=8192

# BLE — NimBLE (más eficiente que Bluedroid para file transfer)
CONFIG_BT_ENABLED=y
CONFIG_BT_NIMBLE_ENABLED=y
CONFIG_BT_NIMBLE_MAX_CONNECTIONS=3
CONFIG_BT_NIMBLE_ATT_PREFERRED_MTU=512
CONFIG_BT_NIMBLE_SVC_GAP_DEVICE_NAME="CamaraESP32"
CONFIG_BT_NIMBLE_LOG_LEVEL_NONE=y

# BT Classic SPP
CONFIG_BT_CLASSIC_ENABLED=y
CONFIG_BT_SPP_ENABLED=y
CONFIG_BT_BLE_ENABLED=y

# SD Card (SDMMC)
CONFIG_SOC_SDMMC_HOST_SUPPORTED=y

# Logging
CONFIG_LOG_DEFAULT_LEVEL_INFO=y
CONFIG_LOG_MAXIMUM_LEVEL_DEBUG=y

# Task stack sizes
CONFIG_ESP_MAIN_TASK_STACK_SIZE=8192
CONFIG_ESP_SYSTEM_EVENT_TASK_STACK_SIZE=4096

# FreeRTOS
CONFIG_FREERTOS_USE_TRACE_FACILITY=y
CONFIG_FREERTOS_GENERATE_RUN_TIME_STATS=y

# Watchdog — aumentamos timeout para operaciones de SD largas
CONFIG_ESP_TASK_WDT_TIMEOUT_S=10
CONFIG_ESP_INT_WDT_TIMEOUT_MS=800

# FATFS Long File Names (LFN) para nombres con fecha
CONFIG_FATFS_LFN_HEAP=y
CONFIG_FATFS_MAX_LFN=255
```
